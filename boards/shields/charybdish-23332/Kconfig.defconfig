## boards/shields/charybdish-23332/Kconfig.defconfig
```kconfig
if SHIELD_CHARYBDISH_23332_RIGHT

# Name must be less than 16 characters long!
config ZMK_KEYBOARD_NAME
    default "Charybdish"

config ZMK_SPLIT_ROLE_CENTRAL
    default y

endif

if SHIELD_SKELETYLHW_LEFT || SHIELD_SKELETYLHW_RIGHT

config ZMK_SPLIT
    default y

endif
```

## boards/shields/charybdish-23332/Kconfig.shield
```kconfig
config SHIELD_CHARYBDISH_23332_LEFT
    def_bool $(shields_list_contains,charybdish-23332_left)

config SHIELD_CHARYBDISH_23332_RIGHT
    def_bool $(shields_list_contains,charybdish-23332_right)
```
